## drivers/platform/mips/Kconfig
```kconfig
# SPDX-License-Identifier: GPL-2.0-only
#
# MIPS Platform Specific Drivers
#

menuconfig MIPS_PLATFORM_DEVICES
	bool "MIPS Platform Specific Device Drivers"
	default y
	depends on MIPS
	help
	  Say Y here to get to see options for device drivers of various
	  MIPS platforms, including vendor-specific netbook/laptop/desktop
	  extension and hardware monitor drivers. This option itself does
	  not add any kernel code.

	  If you say N, all options in this submenu will be skipped and disabled.

if MIPS_PLATFORM_DEVICES

config CPU_HWMON
	bool "Loongson-3 CPU HWMon Driver"
	depends on MACH_LOONGSON64
	select HWMON
	default y
	help
	  Loongson-3A/3B CPU Hwmon (temperature sensor) driver.

config RS780E_ACPI
	bool "Loongson RS780E ACPI Controller"
	depends on MACH_LOONGSON64 || COMPILE_TEST
	help
	  Loongson RS780E PCH ACPI Controller driver.

config LS2K_RESET
	bool "Loongson-2K1000 Reset Controller"
	depends on MACH_LOONGSON64 || COMPILE_TEST
	help
	  Loongson-2K1000 Reset Controller driver.

config TPLINK_ST1008F_MODE_SWITCH
	tristate "TP-Link TL-ST1008F v2 mode switch"
	depends on MACH_REALTEK_RTL || COMPILE_TEST
	depends on OF && GPIOLIB && I2C && NETDEVICES && (HWMON || HWMON=n)
	select PHYLINK
	select SFP
	help
	  Reads the TL-ST1008F v2 3-position mode switch (GPIO 17-19) like the
	  stock firmware and applies its 1G/2.5G speed pattern to 1G and 2.5G
	  SFP modules. 10G modules are not touched. Also sums the power
	  every fitted module declares and warns over a budget.

endif # MIPS_PLATFORM_DEVICES
```
